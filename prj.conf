## CMakeLists.txt
```
# SPDX-License-Identifier: Apache-2.0

cmake_minimum_required(VERSION 3.20.0)

find_package(Zephyr REQUIRED HINTS $ENV{ZEPHYR_BASE})
project(adc_respiratory)

target_sources(app PRIVATE src/main.c src/ble_send.c src/respiratory.pb.c src/adc_control.c src/ppi_config.c)
```

## prj.conf
```kconfig
#CONFIG_LOG_PROCESS_THREAD_SLEEP_MS=100

#CONFIG_GPIO=y
CONFIG_NRFX_GPIOTE0=y
CONFIG_NRFX_SAADC=y

CONFIG_CBPRINTF_FP_SUPPORT=y
CONFIG_NANOPB=y

#bluetooth
CONFIG_BT=y
CONFIG_SETTINGS=y
CONFIG_BT_SMP=y
CONFIG_BT_SIGNING=y
CONFIG_BT_PERIPHERAL=y
CONFIG_BT_ATT_PREPARE_COUNT=5
CONFIG_BT_BAS=y

CONFIG_BT_PRIVACY=y
CONFIG_BT_DEVICE_NAME="UU_RESPIRATORY"
CONFIG_BT_DEVICE_APPEARANCE=541
CONFIG_BT_DEVICE_NAME_DYNAMIC=n
CONFIG_BT_SETTINGS=y
CONFIG_BT_USER_DATA_LEN_UPDATE=y

CONFIG_BT_BUF_ACL_RX_SIZE=83
CONFIG_BT_L2CAP_TX_MTU=83
CONFIG_BT_L2CAP_DYNAMIC_CHANNEL=y
CONFIG_BT_BUF_ACL_TX_COUNT=10
CONFIG_BT_BUF_ACL_TX_SIZE=83

#CONFIG_HEAP_MEM_POOL_SIZE=2048

CONFIG_GPIO=y
#CONFIG_NRFX_PWM=y

#debug:
CONFIG_CORTEX_M_DEBUG_MONITOR_HOOK=y
CONFIG_SEGGER_DEBUGMON=y
CONFIG_DEBUG_OPTIMIZATIONS=y
CONFIG_DEBUG_THREAD_INFO=y
CONFIG_LOG=y
```

## sense.conf
```kconfig
#CONFIG_LOG_PROCESS_THREAD_SLEEP_MS=100

#CONFIG_GPIO=y
CONFIG_NRFX_GPIOTE0=y
CONFIG_NRFX_SAADC=y


CONFIG_CBPRINTF_FP_SUPPORT=y
CONFIG_NANOPB=y

#bluetooth
CONFIG_BT=y
CONFIG_SETTINGS=y
CONFIG_BT_SMP=y
CONFIG_BT_SIGNING=y
CONFIG_BT_PERIPHERAL=y
CONFIG_BT_ATT_PREPARE_COUNT=5
CONFIG_BT_BAS=y

CONFIG_BT_PRIVACY=y
CONFIG_BT_DEVICE_NAME="UU_RESPIRATORY"
CONFIG_BT_DEVICE_APPEARANCE=541
CONFIG_BT_DEVICE_NAME_DYNAMIC=n
CONFIG_BT_SETTINGS=y
CONFIG_BT_USER_DATA_LEN_UPDATE=y

CONFIG_BT_BUF_ACL_RX_SIZE=83
CONFIG_BT_L2CAP_TX_MTU=83
CONFIG_BT_L2CAP_DYNAMIC_CHANNEL=y
CONFIG_BT_BUF_ACL_TX_COUNT=10
CONFIG_BT_BUF_ACL_TX_SIZE=83

CONFIG_HEAP_MEM_POOL_SIZE=2048

CONFIG_PM_DEVICE=y
CONFIG_USB_DEVICE_STACK=n
CONFIG_POWEROFF=y

CONFIG_LOG=n

CONFIG_PWM=y
CONFIG_GPIO=y
#debug:
# CONFIG_CORTEX_M_DEBUG_MONITOR_HOOK=y
# CONFIG_SEGGER_DEBUGMON=y
# CONFIG_DEBUG_OPTIMIZATIONS=y
# CONFIG_DEBUG_THREAD_INFO=y
# CONFIG_LOG=y
```

## nrf52840dk_nrf52840.overlay
```dts
/ {
    // zephyr,user {
    // /* period cell corresponds to initial period */
    //     pwms = <&pwm0 0 PWM_HZ(16000000) PWM_POLARITY_NORMAL>;
    // //    signal-gpios = <&gpio0 4 GPIO_ACTIVE_HIGH>;
    // };
};

// &pinctrl {
//     pwm0_default: pwm0_default {
// 		group1 {
// 			psels = <NRF_PSEL(PWM_OUT0, 0, 5)>;
// 			nordic,invert;
// 		};
// 	};

// 	pwm0_sleep: pwm0_sleep {
// 		group1 {
// 			psels = <NRF_PSEL(PWM_OUT0, 0, 3)>;
// 			low-power-enable;
// 		};
// 	};
//};
```

## src/main.c
```c
#include <zephyr/kernel.h>
#include <nrfx_saadc.h>
#include <nrfx_gpiote.h>
#include <zephyr/logging/log.h>
#include "adc_control.h"

int main(void)
{          
        k_sleep(K_FOREVER);     
}
```

## src/adc_control.c
```c
/*
 * Copyright (c) 2022 - 2024, Nordic Semiconductor ASA
 * All rights reserved.
 *
 * SPDX-License-Identifier: BSD-3-Clause
 *
*/

#include <zephyr/kernel.h>
#include <nrfx_saadc.h>
#include <nrfx_gpiote.h>
#include <zephyr/logging/log.h>
#include "adc_control.h"
#include "ble_send.h"

LOG_MODULE_REGISTER(SAADC_MODULE, CONFIG_LOG_DEFAULT_LEVEL);

//K_HEAP_DEFINE(BUFFER,512);


/**
 * @defgroup nrfx_saadc_advanced_non_blocking_internal_timer_example Advanced non-blocking sampling with internal timer SAADC example
 * @{
 * @ingroup nrfx_saadc_examples
 *
 * @brief Example showing advanced functionality of nrfx_saadc driver operating in the non-blocking continuous sampling mode with internal timer.
 *
 * @details Application initializes nrfx_saadc driver and starts operating in the non-blocking mode.
 *          In the example, @ref m_single_channel is configured and the SAADC driver is set to the advanced mode
 *          with @p nrfx_saadc_adv_config_t::start_on_end enabled. With that flag @p NRF_SAADC_TASK_START task
 *          is triggered on the @p NRF_SAADC_EVENT_END event automatically by the SAADC driver.
 *
 *          Calibration in a non-blocking manner is triggered by @p nrfx_saadc_offset_calibrate. Then, upon receiving @p NRFX_SAADC_EVT_CALIBRATEDONE
 *          event in @ref saadc_handler() sampling is initiated by calling @p nrfx_saadc_mode_trigger() function.
 *          Consecutive sample tasks are triggered by the internal timer at the sample rate specified in  @ref SAADC_SAMPLE_FREQUENCY symbol.
 *
 *          The example features GPPI channel configured to test the functionality of SAADC. The endpoints are setup up in a way
 *          that @p NRF_SAADC_EVENT_RESULTDONE event is connected with the GPIOTE task that toggles the @ref OUT_GPIO_PIN pin.
 *
 *          Please note that the internal timer can only be used in the non-blocking mode with only a single input channel enabled.
 */

/** @brief Symbol specifying analog input to be observed by SAADC channel 0. */
#define CH0_AIN ANALOG_INPUT_TO_SAADC_AIN(ANALOG_INPUT_A0)

/** @brief Symbol specifying GPIOTE instance to be used. */
#define GPIOTE_INST_IDX 0

/** @brief Symbol specifying GPIO pin used to test the functionality of SAADC. */
#define OUT_GPIO_PIN LOOPBACK_PIN_1B

/** @brief Acquisition time [us] for source resistance <= 800 kOhm (see SAADC electrical specification). */
#define ACQ_TIME_10K 40UL

/** @brief Conversion time [us] (see SAADC electrical specification). */
#define CONV_TIME 2UL

/** @brief Internal timer frequency [Hz] is derived from PCLK16M (see SAMPLERATE register in SAADC). */
#define INTERNAL_TIMER_FREQ 16000000UL

/** @brief SAADC sample frequency for the continuous sampling. */
#define SAADC_SAMPLE_FREQUENCY 8000UL // 8000UL

/** @brief Internal timer capture and compare value. */
#define INTERNAL_TIMER_CC (INTERNAL_TIMER_FREQ / SAADC_SAMPLE_FREQUENCY)

/**
 * @brief Symbol specifying the number of sample buffers ( @ref m_sample_buffers ).
 * Two buffers are required for performing double-buffered conversions.
 */
#define BUFFER_COUNT 2UL

/** @brief Symbol specifying the size of singular sample buffer ( @ref m_sample_buffers ). */
//#define BUFFER_SIZE 5UL //means 40Hz

/** @brief Symbol specifying the resolution of the SAADC. */
#define RESOLUTION NRF_SAADC_RESOLUTION_12BIT

/** @brief SAADC channel configuration structure for single channel use. */
static const nrfx_saadc_channel_t m_single_channel = SAADC_CHANNEL_SE_ACQ_3US(CH0_AIN, 0);

/** @brief Samples buffer to store values from a single channel ( @ref m_single_channel). */

static uint16_t m_sample_buffers[BUFFER_COUNT][MESSAGE_NUM];


/** For continuous sampling the sample rate SAADC_SAMPLE_FREQUENCY should fulfill the following criteria (see SAADC Continuous sampling). */
NRFX_STATIC_ASSERT(SAADC_SAMPLE_FREQUENCY <= (1000000UL / (ACQ_TIME_10K + CONV_TIME)));

/** Possible range value of a CC field in the SAMPLERATE register (SAADC) is 80-2047. */
NRFX_STATIC_ASSERT((INTERNAL_TIMER_CC >= 80UL ) && (INTERNAL_TIMER_CC <= 2047UL));

/**
 * @brief Function for handling SAADC driver events.
 *
 * @param[in] p_event Pointer to an SAADC driver event.
 */



int16_t result_items[MESSAGE_NUM] = {0};

void dataready_handler(struct k_work *work) {
    
    LOG_INF("dataready_handler");
    
    ble_notify_respiratory_proc(result_items);    
}

bool continuereading = false;

void adc_stop(struct k_work *work) {
    continuereading = false;
}

K_WORK_DEFINE(dataready_worker, dataready_handler);

static void saadc_handler(nrfx_saadc_evt_t const * p_event)
{
    nrfx_err_t status;
    (void)status;

    static uint16_t buffer_index = 1;

    
    uint16_t samples_number;

    switch (p_event->type)
    {
        case NRFX_SAADC_EVT_CALIBRATEDONE:
            LOG_INF("SAADC event: CALIBRATEDONE");

            status = nrfx_saadc_mode_trigger();
            NRFX_ASSERT(status == NRFX_SUCCESS);
            break;

        case NRFX_SAADC_EVT_READY:
            LOG_INF("SAADC event: READY");
            break;

        case NRFX_SAADC_EVT_BUF_REQ:
            LOG_INF("SAADC event: BUF_REQ");

            if (continuereading)
            {
                /* Next available buffer must be set on the NRFX_SAADC_EVT_BUF_REQ event to achieve the continuous conversion. */
                status = nrfx_saadc_buffer_set(m_sample_buffers[buffer_index++], MESSAGE_NUM);
                NRFX_ASSERT(status == NRFX_SUCCESS);
                buffer_index = buffer_index % BUFFER_COUNT;
            }
            break;

        case NRFX_SAADC_EVT_DONE:
            samples_number = p_event->data.done.size; 
            
            for (int16_t i = 0; i < samples_number; i++)
            {                
                result_items[i] = NRFX_SAADC_SAMPLE_GET(RESOLUTION, p_event->data.done.p_buffer, i);
            } 
            LOG_INF("first item:%d", result_items[0]);
                    
            k_work_submit(&dataready_worker);       

            break;

        case NRFX_SAADC_EVT_FINISHED:
            LOG_INF("SAADC event: FINISHED");
            break;

        default:
            break;
    }
}

#define NRFX_SAADC_BB_CONFIG                                           \
{                                                                               \
    .oversampling      = NRF_SAADC_OVERSAMPLE_256X,                         \
    .burst             = NRF_SAADC_BURST_DISABLED,                              \
    .internal_timer_cc = 0,                                                     \
    .start_on_end      = false,                                                 \
}

void calibrate_and_start(struct k_work *work) {
    continuereading = true;
    nrfx_err_t status;
    status = nrfx_saadc_init(NRFX_SAADC_DEFAULT_CONFIG_IRQ_PRIORITY);
    NRFX_ASSERT(status == NRFX_SUCCESS);

    status = nrfx_saadc_channel_config(&m_single_channel);
    NRFX_ASSERT(status == NRFX_SUCCESS);

    nrfx_saadc_adv_config_t adv_config = NRFX_SAADC_BB_CONFIG;
    adv_config.internal_timer_cc = INTERNAL_TIMER_CC;
    adv_config.start_on_end = true;

    uint32_t channel_mask = nrfx_saadc_channels_configured_get();
    status = nrfx_saadc_advanced_mode_set(channel_mask,
                                          RESOLUTION,
                                          &adv_config,
                                          saadc_handler);
    NRFX_ASSERT(status == NRFX_SUCCESS);

    status = nrfx_saadc_buffer_set(m_sample_buffers[0], MESSAGE_NUM);
    NRFX_ASSERT(status == NRFX_SUCCESS);

    
    status = nrfx_saadc_offset_calibrate(saadc_handler);
    NRFX_ASSERT(status == NRFX_SUCCESS);
}

/**
 * @brief Function for application main entry.

 */
static int configureSAADC(void)
{          
    // IRQ_CONNECT(NRFX_IRQ_NUMBER_GET(NRF_GPIOTE_INST_GET(GPIOTE_INST_IDX)), IRQ_PRIO_LOWEST,
    //             NRFX_GPIOTE_INST_HANDLER_GET(GPIOTE_INST_IDX), 0, 0);
    IRQ_CONNECT(NRFX_IRQ_NUMBER_GET(NRF_SAADC), IRQ_PRIO_LOWEST, nrfx_saadc_irq_handler, 0, 0);

    
    LOG_INF("Starting nrfx_saadc");
    

  

    // nrfx_gpiote_t const gpiote_inst = NRFX_GPIOTE_INSTANCE(GPIOTE_INST_IDX);
    // status = nrfx_gpiote_init(&gpiote_inst, NRFX_GPIOTE_DEFAULT_CONFIG_IRQ_PRIORITY);
    // NRFX_ASSERT(status == NRFX_SUCCESS);
    // LOG_INF("GPIOTE status: %s", nrfx_gpiote_init_check(&gpiote_inst) ? "initialized" : "not initialized");

    // pin_on_event_toggle_setup(&gpiote_inst, OUT_GPIO_PIN,
    //                           nrf_saadc_event_address_get(NRF_SAADC, NRF_SAADC_EVENT_RESULTDONE));    
    return 0;
}

/** @} */

SYS_INIT(configureSAADC, APPLICATION, CONFIG_APPLICATION_INIT_PRIORITY);
```

## src/adc_control.h
```c
#ifndef ADC_CONTROL__
#define ADC_CONTROL__

#include <zephyr/kernel.h>

#define LOOPBACK_PIN_1A 3
#define LOOPBACK_PIN_1B 31
#define LOOPBACK_PIN_2A 4
#define LOOPBACK_PIN_2B 30
#define LOOPBACK_PIN_3A 28
#define LOOPBACK_PIN_3B 29
#define LOOPBACK_PIN_4A 26
#define LOOPBACK_PIN_4B 27
#define ANALOG_INPUT_A0 1
#define ANALOG_INPUT_A1 2
#define ANALOG_INPUT_A2 4

#define LED1_PIN        13
#define LED2_PIN        14
#define LED3_PIN        15
#define LED4_PIN        16

#define ANALOG_INPUT_TO_SAADC_AIN(x) ((x) + 1)
#define ANALOG_INPUT_TO_COMP_AIN(x) (x)

/**
 * @brief SAADC channel configuration for the single-ended mode with 3 us sample acquisition time.
 *        The 3 us acquisition time will work correctly when the source resistance of @p _pin_p input
 *        analog pin is less than 10 kOhm.
 *
 * This configuration sets up single-ended SAADC channel with the following options:
 * - resistor ladder disabled
 * - gain: 1/6
 * - reference voltage: internal 0.6 V
 * - sample acquisition time: 3 us
 * - burst disabled
 *
 * @param[in] _pin_p Positive input analog pin.
 * @param[in] _index Channel index.
 *
 * @sa nrfx_saadc_channel_t
 */
#define SAADC_CHANNEL_SE_ACQ_3US(_pin_p, _index)        \
{                                                       \
    .channel_config =                                   \
    {                                                   \
        .resistor_p = NRF_SAADC_RESISTOR_DISABLED,      \
        .resistor_n = NRF_SAADC_RESISTOR_DISABLED,      \
        .gain       = NRF_SAADC_GAIN1_2,                \
        .reference  = NRF_SAADC_REFERENCE_INTERNAL,     \
        .acq_time   = NRF_SAADC_ACQTIME_40US,            \
        .mode       = NRF_SAADC_MODE_SINGLE_ENDED,      \
        .burst      = NRF_SAADC_BURST_DISABLED,         \
    },                                                  \
    .pin_p          = (nrf_saadc_input_t)_pin_p,        \
    .pin_n          = NRF_SAADC_INPUT_DISABLED,         \
    .channel_index  = _index,                           \
}


extern void calibrate_and_start(struct k_work *work);
extern void adc_stop(struct k_work *work);

#endif
```

## src/ble_send.c
```c
#include <zephyr/types.h>
#include <stddef.h>
#include <string.h>
#include <errno.h>

#include <zephyr/sys/byteorder.h>
#include <zephyr/kernel.h>

#include <zephyr/settings/settings.h>

#include <zephyr/bluetooth/bluetooth.h>
#include <zephyr/bluetooth/hci.h>
#include <zephyr/bluetooth/conn.h>
#include <zephyr/bluetooth/uuid.h>
#include <zephyr/bluetooth/gatt.h>

#include <zephyr/logging/log.h>
#include <pb_encode.h>
#include <pb_decode.h>
#include "adc_control.h"
#include "respiratory.pb.h"
#include "ble_send.h"
#include "ppi_config.h" 


LOG_MODULE_REGISTER(BLE_MODULE, CONFIG_LOG_DEFAULT_LEVEL);

uint8_t notify_ble_resp_on1 =0;

//general service
static struct bt_uuid_128 respiratory_general_prop = BT_UUID_INIT_128(
	BT_UUID_128_ENCODE(0xa5c47c93, 0x8a02, 0x4ca5, 0x976e, 0xde7b871f11f3));

//notify service 
static struct bt_uuid_128 respiratory_notify_prop = BT_UUID_INIT_128(
	BT_UUID_128_ENCODE(0xd67b5503, 0xa25c, 0x4395, 0xbd21, 0xf92823d91442));

static uint8_t respiratory_notify_buff[adcResults_size];

//protobuf encode sensor data, vector_n has 10 entries.
static int encode_data(int16_t vector_n[], uint8_t *protobuf_packed, size_t *packed_size) {
	bool status;

	adcResults message = adcResults_init_zero;
	/* Create a stream that will write to our buffer. */
	pb_ostream_t stream = pb_ostream_from_buffer(protobuf_packed, adcResults_size);	
	
	for(int i = 0; i<MESSAGE_NUM; i++) {
		message.resp[i] = vector_n[i];
	}	

	status = pb_encode(&stream, &adcResults_msg, &message);
	*packed_size = stream.bytes_written;

	LOG_INF("Encoded, actual protobuf message size was %d", stream.bytes_written); //PRIu64

	if (!status) {
		LOG_ERR("Encoding failed: %s\n", PB_GET_ERROR(&stream));
	}

	return status;
}



const struct bt_data ad[] = {
		BT_DATA_BYTES(BT_DATA_FLAGS, (BT_LE_AD_GENERAL | BT_LE_AD_NO_BREDR)),
		BT_DATA_BYTES(BT_DATA_UUID16_ALL, ),	};
		//BT_DATA_BYTES(BT_DATA_UUID128_ALL, motiondata_prop),
// 			BT_DATA(BT_DATA_MANUFACTURER_DATA, uniqueId, sizeof(ui))
// 	};
// }

void mtu_updated(struct bt_conn *conn, uint16_t tx, uint16_t rx)
{
	LOG_INF("Updated MTU: TX: %d RX: %d bytes\n", tx, rx);
}

static struct bt_gatt_cb gatt_callbacks = {
	.att_mtu_updated = mtu_updated
};

static void connected(struct bt_conn *conn, uint8_t err)
{
	if (err) {
		LOG_INF("Connection failed (err 0x%02x)\n", err);
	} else {
		LOG_INF("Connected\n");
	}
}

static void disconnected(struct bt_conn *conn, uint8_t reason)
{
	LOG_INF("Disconnected (reason 0x%02x)\n", reason);
}

static void le_data_length_updated(struct bt_conn *conn, struct bt_conn_le_data_len_info *info) {
	LOG_INF("LE data len updated: TX (len: %d time: %d)"
	       " RX (len: %d time: %d)\n", info->tx_max_len,
	       info->tx_max_time, info->rx_max_len, info->rx_max_time);
}

BT_CONN_CB_DEFINE(conn_callbacks) = {
	.connected = connected,
	.disconnected = disconnected,
	.le_data_len_updated = le_data_length_updated,
};

K_WORK_DEFINE(startcollecting, calibrate_and_start);
K_WORK_DEFINE(start_emitting, ppi_start);
K_WORK_DEFINE(stop_emitting, ppi_stop);
K_WORK_DEFINE(stop_adc, adc_stop);

static void resp_readmotion_data_notify_changed(const struct bt_gatt_attr *attr, uint16_t value) {
	notify_ble_resp_on1 = (value == BT_GATT_CCC_NOTIFY) ? 1 : 0;
	LOG_INF("resp_notify_changed");
	if(notify_ble_resp_on1) {
		k_work_submit(&startcollecting);
		k_work_submit(&start_emitting);
	} else {		
		k_work_submit(&stop_emitting);
		k_work_submit(&stop_adc);
	}
}

BT_GATT_SERVICE_DEFINE(motion_svc,
	BT_GATT_PRIMARY_SERVICE(&respiratory_general_prop),
	
	BT_GATT_CHARACTERISTIC(&respiratory_notify_prop.uuid, 
	 		       BT_GATT_CHRC_READ | BT_GATT_CHRC_NOTIFY,
	 		       BT_GATT_PERM_READ,
	 		       NULL, NULL, respiratory_notify_buff),
	BT_GATT_CCC(resp_readmotion_data_notify_changed, BT_GATT_PERM_READ | BT_GATT_PERM_WRITE)
);



#define BT_CONN_CUSTOM BT_LE_ADV_PARAM(BT_LE_ADV_OPT_CONNECTABLE | \
					    BT_LE_ADV_OPT_USE_NAME, \
					    768, 1024, NULL) //*1.25ms


static void bt_ready(void)
{
	int err;

	LOG_INF("Bluetooth initialized\n");	

	if (IS_ENABLED(CONFIG_SETTINGS)) {
		settings_load();
	}

	err = bt_le_adv_start(BT_CONN_CUSTOM, ad, ARRAY_SIZE(ad), NULL, 0);
	if (err) {
		LOG_ERR("Advertising failed to start (err %d)\n", err);
		return;
	}

	LOG_INF("Advertising successfully started\n");
}

static void auth_cancel(struct bt_conn *conn)
{
	char addr[BT_ADDR_LE_STR_LEN];

	bt_addr_le_to_str(bt_conn_get_dst(conn), addr, sizeof(addr));

	LOG_INF("Pairing cancelled: %s\n", addr);
}

static struct bt_conn_auth_cb auth_cb_display = {
	.passkey_display = NULL,// auth_passkey_display,
	.passkey_entry = NULL,
	.cancel = auth_cancel,
	.passkey_confirm = NULL,	
};

int ble_load()
{		
	int err;

	err = bt_enable(NULL);
	if (err) {
		LOG_INF("Bluetooth init failed (err %d)\n", err);
		return 0;
	}

	bt_ready();

	bt_gatt_cb_register(&gatt_callbacks);
	bt_conn_auth_cb_register(&auth_cb_display);

	//clean up bonds
	bt_unpair(BT_ID_DEFAULT, BT_ADDR_LE_ANY);
	
	return err;
}



void ble_notify_respiratory_proc(int16_t adcitems[]) {		
	struct bt_gatt_attr *notify_attr = bt_gatt_find_by_uuid(motion_svc.attrs, motion_svc.attr_count, &respiratory_notify_prop.uuid);
	    
        if(notify_ble_resp_on1){

			size_t packed_size;        

			encode_data(adcitems, respiratory_notify_buff, &packed_size);
			LOG_INF("notify:");
			bt_gatt_notify(NULL, notify_attr, respiratory_notify_buff, packed_size);			
		}    
}


// K_THREAD_DEFINE(ble_sender, 2048, ble_notify_respiratory_proc,  NULL, NULL, NULL, 7, 0, 0);
SYS_INIT(ble_load, APPLICATION, CONFIG_APPLICATION_INIT_PRIORITY);
```

## src/ble_send.h
```c
#ifndef BLE_SEND__
#define BLE_SEND__


#define MESSAGE_NUM 5


extern void ble_notify_respiratory_proc(int16_t adcitems[]);


#endif
```

## src/ppi_config.c
```c
#include <zephyr/kernel.h>
#include <zephyr/sys/printk.h>
#include <zephyr/drivers/gpio.h>
#include <zephyr/device.h>
#include <zephyr/logging/log.h>

   /* Copyright (c) 2013 Nordic Semiconductor. All Rights Reserved.
 *
 * Use of this source code is governed by a BSD-style license that can be
 * found in the license.txt file.
 */
/*
 * See README.md for a description of the application. 
 */ 
LOG_MODULE_REGISTER(PPI_MODULE, CONFIG_LOG_DEFAULT_LEVEL);

/**
 * @brief Function for application main entry.
 */
int ppi_init(void)
{   
    NRF_CLOCK->TASKS_HFCLKSTART = 1;
    while (NRF_CLOCK->EVENTS_HFCLKSTARTED == 0)
    {
    }
    NRF_CLOCK->EVENTS_HFCLKSTARTED = 0;
    
    // Workaround for PAN item 11, nRF51822-PAN v2.0.pdf. Not needed on second revision chips. 
    //NRF_POWER->TASKS_CONSTLAT = 1;
    
    NRF_GPIOTE->CONFIG[0] = GPIOTE_CONFIG_MODE_Task << GPIOTE_CONFIG_MODE_Pos |
                            GPIOTE_CONFIG_POLARITY_Toggle << GPIOTE_CONFIG_POLARITY_Pos |
                            4 << GPIOTE_CONFIG_PSEL_Pos | 
                            GPIOTE_CONFIG_OUTINIT_Low << GPIOTE_CONFIG_OUTINIT_Pos;
                            
    NRF_TIMER1->PRESCALER = 0;
    // Adjust the output frequency by adjusting the CC. 
    // Due to PAN item 33, you can't have this at 1 for first revision chips, and will hence be limited to 4 MHz. 
    NRF_TIMER1->CC[0] = 1;
    NRF_TIMER1->SHORTS = TIMER_SHORTS_COMPARE0_CLEAR_Enabled << TIMER_SHORTS_COMPARE0_CLEAR_Pos;
    //NRF_TIMER1->TASKS_START = 1;
    
    NRF_PPI->CH[0].EEP = (uint32_t) &NRF_TIMER1->EVENTS_COMPARE[0];
    NRF_PPI->CH[0].TEP = (uint32_t) &NRF_GPIOTE->TASKS_OUT[0];
    
    NRF_PPI->CHENSET = PPI_CHENSET_CH0_Enabled << PPI_CHENSET_CH0_Pos;
    return 0;
}

void ppi_start(struct k_work * work) {
    NRF_TIMER1->TASKS_START = 1;
    LOG_INF("ppi started");
}

void ppi_stop(struct k_work * work) {
    NRF_TIMER1->TASKS_STOP = 1;
    LOG_INF("ppi stopped");
}

SYS_INIT(ppi_init, APPLICATION, CONFIG_APPLICATION_INIT_PRIORITY);
/** @} */
```

## src/ppi_config.h
```c
#ifndef __PPI_CONFIG_H
#define __PPI_CONFIG_H

//start signal 
void ppi_start(struct k_work *work);
void ppi_stop(struct k_work *work);

#endif
```

## src/pwm_config.c
```c
#include <zephyr/kernel.h>
#include <zephyr/sys/printk.h>
#include <zephyr/drivers/gpio.h>
#include <zephyr/drivers/pwm.h>
#include <zephyr/device.h>

#include "pwm_config.h"
#include <stdio.h>
#include <string.h>
#include <nrfx_pwm.h>


#define ZEPHYR_USER_NODE DT_PATH(zephyr_user)

static const struct pwm_dt_spec pwm = PWM_DT_SPEC_GET(DT_PATH(zephyr_user));

//static uint32_t period;
//static struct k_work beep_work;
//static volatile bool beep_active;

//static const struct gpio_dt_spec sw0_gpio = GPIO_DT_SPEC_GET(DT_ALIAS(sw0), gpios);
//static const struct gpio_dt_spec sw1_gpio = GPIO_DT_SPEC_GET(DT_ALIAS(sw1), gpios);

/* ensure SW0 & SW1 are on same gpio controller */
// BUILD_ASSERT(DT_SAME_NODE(DT_GPIO_CTLR(DT_ALIAS(sw0), gpios), DT_GPIO_CTLR(DT_ALIAS(sw1), gpios)));

//static void beep(struct k_work *work)
// {
// 	/* The "period / 2" pulse duration gives 50% duty cycle, which
// 	 * should result in the maximum sound volume.
// 	 */
// 	pwm_set_dt(&pwm, 130, 65);
// 	k_sleep(K_SECONDS(10));

// 	/* Disable the PWM */
// 	pwm_set_pulse_dt(&pwm, 0);	
// }

// static void button_pressed(const struct device *dev, struct gpio_callback *cb,
// 			   uint32_t pins)
// {
	// if (beep_active) {
	// 	printk("Button press while beeping\n");
	// 	return;
	// }

	// beep_active = true;

	// if (pins & BIT(sw0_gpio.pin)) {
	// 	printk("A pressed\n");
	// 	if (period < PERIOD_MAX) {
	// 		period += PWM_USEC(50U);
	// 	}
	// } else {
	// 	printk("B pressed\n");
	// 	if (period > PERIOD_MIN) {
	// 		period -= PWM_USEC(50U);
	// 	}
	// }

	// printk("Period is %u us (%u Hz)\n", period / NSEC_PER_USEC,
	//        NS_TO_HZ(period));


	// printf("%uHz", NS_TO_HZ(period));

	//k_work_submit(&beep_work);
//}

int pwm_init()
{
	// static struct gpio_callback button_cb_data;

	// if (!pwm_is_ready_dt(&pwm)) {
	// 	printk("%s: device not ready.\n", pwm.dev->name);
	// 	return 0;
	// }

	// /* since sw0_gpio.port == sw1_gpio.port, we only need to check ready once */
	// if (!gpio_is_ready_dt(&sw0_gpio)) {
	// 	printk("%s: device not ready.\n", sw0_gpio.port->name);
	// 	return 0;
	// }

	// period = pwm.period;

	// gpio_pin_configure_dt(&sw0_gpio, GPIO_INPUT);
	// gpio_pin_configure_dt(&sw1_gpio, GPIO_INPUT);

	// gpio_pin_interrupt_configure_dt(&sw0_gpio, GPIO_INT_EDGE_TO_ACTIVE);
	// gpio_pin_interrupt_configure_dt(&sw1_gpio, GPIO_INT_EDGE_TO_ACTIVE);

	// gpio_init_callback(&button_cb_data, button_pressed,
	// 		   BIT(sw0_gpio.pin) | BIT(sw1_gpio.pin));

	// k_work_init(&beep_work, beep);
	// /* Notify with a beep that we've started */
	
    // k_work_submit(&beep_work);
	
    // gpio_add_callback(sw0_gpio.port, &button_cb_data);
     pwm_set_dt(&pwm, 250, 125); 

 	return 0;
 }

/**
 * Simple program to drive LED0 on the nrf5340 evaluation board using the nrfx driver for lower level access
 * Jonas Forssell
 */

//#define ZEPHYR_USER_NODE DT_PATH(zephyr_user)

// Use Zephyr macro to get access to the LED0 on the board
//#define OUTPUT_PIN DT_GPIO_PIN(DT_ALIAS(gpios), gpios)
//const struct gpio_dt_spec signal = GPIO_DT_SPEC_GET(ZEPHYR_USER_NODE, signal_gpios);

// Use nrfx to create a PWM instance which we will connect to the LED0 later
//static nrfx_pwm_t m_pwm0 = NRFX_PWM_INSTANCE(0);

// // Declare variables holding PWM sequence values. In this example only one channel is used 
// nrf_pwm_values_individual_t seq_values[4] = {0};
// nrf_pwm_sequence_t const seq =
// {
//     .values.p_individual = seq_values,
//     .length          = NRF_PWM_VALUES_LENGTH(seq_values),
//     .repeats         = 0,
//     .end_delay       = 0
// };


// Set duty cycle between 0 and 100%
// void pwm_update_duty_cycle(uint8_t duty_cycle)
// {
    
//     // Check if value is outside of range. If so, set to 100%
//     if(duty_cycle >= 100)
//     {
//         seq_values->channel_0 = 100;
//     }
//     else
//     {
//         seq_values->channel_0 = duty_cycle;
//     }
    
//     nrfx_pwm_simple_playback(&m_pwm0, &seq, 1, NRFX_PWM_FLAG_LOOP);
// }

// #define OUTPUT_PIN	DT_GPIO_PIN(DT_ALIAS(led0), gpios)

// static int pwm_init(void)
// {
// 	nrfx_pwm_config_t const config0 =
//     {
//         .output_pins =
//         {
//             OUTPUT_PIN,                        // channel 0 now connected to LED0
//             // NRFX_PWM_PIN_NOT_USED,             // channel 1
//             // NRFX_PWM_PIN_NOT_USED,             // channel 2
//             // NRFX_PWM_PIN_NOT_USED,             // channel 3
//         },
//         .irq_priority = NRFX_PWM_DEFAULT_CONFIG_IRQ_PRIORITY,
//         .base_clock   = NRF_PWM_CLK_16MHz,
//         .count_mode   = NRF_PWM_MODE_UP,
//         .top_value    = 1,
//         .load_mode    = NRF_PWM_LOAD_INDIVIDUAL,
//         .step_mode    = NRF_PWM_STEP_AUTO		
//     };
// 	/* Connect PWM0 IRQ to nrfx_pwm_irq_handler */
// 	IRQ_CONNECT(DT_IRQN(DT_NODELABEL(pwm0)), DT_IRQ(DT_NODELABEL(pwm0), priority), nrfx_isr,
// 		    NRFX_PWM_INST_HANDLER_GET(0), 0);

//     // Init PWM without error handler
//     int ret = nrfx_pwm_init(&m_pwm0, &config0, NULL, NULL);
// 	if(ret != 0) {
// 		printf("error initiating PWM: %d", ret);
// 	} else {
// 		printf("pwm initiated");
// 	}

// 	    // PWM Sequence: Example with constant 50% duty cycle
//     static nrf_pwm_values_individual_t pwm_values = {1, 0,0,0};  // Adjust for duty cycle
//     static nrf_pwm_sequence_t const seq =
//     {
//         .values.p_individual = &pwm_values,
//         .length              = NRF_PWM_VALUES_LENGTH(pwm_values),
//         .repeats             = 0,  // No additional repeats
//         .end_delay           = 0   // No delay between loops
//     };

//     // Start PWM playback in infinite loop
//     nrfx_pwm_simple_playback(&m_pwm0, &seq, 0, NRFX_PWM_FLAG_LOOP);

	
//     return 0;
// }


// int main(void)
// {

//     // Start clock for accurate frequencies
//    // NRF_CLOCK->TASKS_HFCLKSTART = 1; 
//     // Wait for clock to start
//     // while(NRF_CLOCK->EVENTS_HFCLKSTARTED == 0) 
//     //     ;
    
//     pwm_init();

//     for (;;)
//     {
//         for(int i = 0; i <= 100; i++)
//         {
//             k_msleep(10);
//             pwm_update_duty_cycle(i);
//         }
//     }
// }


/** @} */

SYS_INIT(pwm_init, APPLICATION, CONFIG_APPLICATION_INIT_PRIORITY);
```

## src/pwm_config.h
```c
#ifndef __PWM_CONFIG_
#define __PWM_CONFIG_

// #define PERIOD_MIN     PWM_USEC(50)
// #define PERIOD_MAX     PWM_USEC(3900)

// #define BEEP_DURATION  K_MSEC(60)

// #define NS_TO_HZ(_ns)  (NSEC_PER_SEC / (_ns))

#endif
```

## src/respiratory.pb.c
```c
/* Automatically generated nanopb constant definitions */
/* Generated by nanopb-0.4.8 */

#include "respiratory.pb.h"
#if PB_PROTO_HEADER_VERSION != 40
#error Regenerate this file with the current version of nanopb generator.
#endif

PB_BIND(adcResults, adcResults, AUTO)
```

## src/respiratory.pb.h
```c
/* Automatically generated nanopb header */
/* Generated by nanopb-0.4.8 */

#ifndef PB_RESPIRATORY_PB_H_INCLUDED
#define PB_RESPIRATORY_PB_H_INCLUDED
#include <pb.h>

#if PB_PROTO_HEADER_VERSION != 40
#error Regenerate this file with the current version of nanopb generator.
#endif

/* Struct definitions */
typedef struct _adcResults {
    int32_t resp[5];
} adcResults;


#ifdef __cplusplus
extern "C" {
#endif

/* Initializer values for message structs */
#define adcResults_init_default                  {{0, 0, 0, 0, 0}}
#define adcResults_init_zero                     {{0, 0, 0, 0, 0}}

/* Field tags (for use in manual encoding/decoding) */
#define adcResults_resp_tag                      1

/* Struct field encoding specification for nanopb */
#define adcResults_FIELDLIST(X, a) \
X(a, STATIC,   FIXARRAY, INT32,    resp,              1)
#define adcResults_CALLBACK NULL
#define adcResults_DEFAULT NULL

extern const pb_msgdesc_t adcResults_msg;

/* Defines for backwards compatibility with code written before nanopb-0.4.0 */
#define adcResults_fields &adcResults_msg

/* Maximum encoded size of messages (where known) */
#define RESPIRATORY_PB_H_MAX_SIZE                adcResults_size
#define adcResults_size                          55

#ifdef __cplusplus
} /* extern "C" */
#endif

#endif
```
